## boards/arm/segl/Kconfig.board
```kconfig
# SPDX-License-Identifier: MIT

config BOARD_SEGL
    bool "Hringbord Segl"
    depends on SOC_RP2040
    select RP2_FLASH_GENERIC_03H
```

## boards/arm/segl/Kconfig.defconfig
```kconfig
# SPDX-License-Identifier: MIT

if BOARD_SEGL

config BOARD
    default "segl"

config ZMK_KEYBOARD_NAME
    default "Segl"

endif
```

## boards/arm/segl/board.yml
```yaml
# SPDX-License-Identifier: MIT

board:
  name: segl
  vendor: hringbord
  type: keyboard
  socs:
    - name: rp2040
```

## boards/arm/segl/segl_defconfig
```kconfig
# SPDX-License-Identifier: MIT

CONFIG_SOC_SERIES_RP2XXX=y
CONFIG_SOC_RP2040=y
CONFIG_BOARD_SEGL=y
CONFIG_SYS_CLOCK_HW_CYCLES_PER_SEC=125000000

CONFIG_GPIO=y
CONFIG_GPIO_RPI_PICO=y
CONFIG_CLOCK_CONTROL=y
CONFIG_RESET=y
CONFIG_USE_DT_CODE_PARTITION=y
CONFIG_BUILD_OUTPUT_UF2=y

CONFIG_ZMK_USB=y
CONFIG_ZMK_KSCAN_CHARLIEPLEX_WAIT_BEFORE_INPUTS=60
CONFIG_ZMK_KSCAN_CHARLIEPLEX_WAIT_BETWEEN_OUTPUTS=60

CONFIG_FLASH=y
CONFIG_FLASH_MAP=y
CONFIG_FLASH_PAGE_LAYOUT=y
CONFIG_NVS=y
CONFIG_SETTINGS_NVS=y
CONFIG_MPU_ALLOW_FLASH_WRITE=y
```

## boards/hringbord/segl/Kconfig.defconfig
```kconfig
# SPDX-License-Identifier: MIT

if BOARD_SEGL

config ZMK_KEYBOARD_NAME
    default "Segl"

endif
```

## boards/hringbord/segl/board.yml
```yaml
# SPDX-License-Identifier: MIT

board:
  name: segl
  vendor: hringbord
  socs:
    - name: rp2040
      variants:
        - name: zmk
```

## boards/hringbord/segl/segl_zmk_defconfig
```kconfig
# SPDX-License-Identifier: MIT

CONFIG_ZMK_USB=y
CONFIG_ZMK_KSCAN_GPIO_CHARLIEPLEX=y
```

## boards/shields/xiao_ble_tweezer/Kconfig.defconfig
```kconfig
# SPDX-License-Identifier: MIT

if SHIELD_XIAO_BLE_TWEEZER

config ZMK_KEYBOARD_NAME
    default "XIAO BLE Tweezer"

endif
```

## boards/shields/xiao_ble_tweezer/Kconfig.shield
```kconfig
# SPDX-License-Identifier: MIT

config SHIELD_XIAO_BLE_TWEEZER
    def_bool $(shields_list_contains,xiao_ble_tweezer)
```
