## boards/shields/smidr_corne/Kconfig.defconfig
```kconfig
# Copyright (c) 2026 Smidr
# SPDX-License-Identifier: MIT

if SHIELD_SMIDR_CORNE_LEFT

config ZMK_KEYBOARD_NAME
    default "Smidr Corne"

config ZMK_SPLIT_ROLE_CENTRAL
    default y

endif

if SHIELD_SMIDR_CORNE_LEFT || SHIELD_SMIDR_CORNE_RIGHT

config ZMK_SPLIT
    default y

endif
```

## boards/shields/smidr_corne/Kconfig.shield
```kconfig
# Copyright (c) 2026 Smidr
# SPDX-License-Identifier: MIT

config SHIELD_SMIDR_CORNE_LEFT
    def_bool $(shields_list_contains,smidr_corne_left)

config SHIELD_SMIDR_CORNE_RIGHT
    def_bool $(shields_list_contains,smidr_corne_right)
```

## boards/shields/smidr_demo_corne/Kconfig.defconfig
```kconfig
# Copyright (c) 2026 Smiðr
# SPDX-License-Identifier: MIT

if SHIELD_SMI_R_DEMO_CORNE_LEFT

config ZMK_KEYBOARD_NAME
    default "Smiðr Demo Corne"

config ZMK_SPLIT_ROLE_CENTRAL
    default y

endif

if SHIELD_SMI_R_DEMO_CORNE_LEFT || SHIELD_SMI_R_DEMO_CORNE_RIGHT

config ZMK_SPLIT
    default y

endif
```

## boards/shields/smidr_demo_corne/Kconfig.shield
```kconfig
# Copyright (c) 2026 Smiðr
# SPDX-License-Identifier: MIT

config SHIELD_SMI_R_DEMO_CORNE_LEFT
    def_bool $(shields_list_contains,smi_r_demo_corne_left)

config SHIELD_SMI_R_DEMO_CORNE_RIGHT
    def_bool $(shields_list_contains,smi_r_demo_corne_right)
```
