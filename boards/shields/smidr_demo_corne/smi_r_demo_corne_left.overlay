#include "smi_r_demo_corne.dtsi"

&kscan0 {
    row-gpios
        = <&gpio0 2 (GPIO_ACTIVE_HIGH | GPIO_PULL_DOWN)> /* Left row 0: P0.02 */
            , <&gpio0 6 (GPIO_ACTIVE_HIGH | GPIO_PULL_DOWN)> /* Left row 1: P0.06 */
            , <&gpio0 8 (GPIO_ACTIVE_HIGH | GPIO_PULL_DOWN)> /* Left row 2: P0.08 */
            , <&gpio0 9 (GPIO_ACTIVE_HIGH | GPIO_PULL_DOWN)> /* Left row 3: P0.09 */
        ;

    col-gpios
        = <&gpio0 10 GPIO_ACTIVE_HIGH> /* Left col 0: P0.10 */
            , <&gpio0 11 GPIO_ACTIVE_HIGH> /* Left col 1: P0.11 */
            , <&gpio0 17 GPIO_ACTIVE_HIGH> /* Left col 2: P0.17 */
            , <&gpio0 20 GPIO_ACTIVE_HIGH> /* Left col 3: P0.20 */
            , <&gpio0 22 GPIO_ACTIVE_HIGH> /* Left col 4: P0.22 */
            , <&gpio0 24 GPIO_ACTIVE_HIGH> /* Left col 5: P0.24 */
        ;
};

&encoder_0 {
    status = "okay";
};

