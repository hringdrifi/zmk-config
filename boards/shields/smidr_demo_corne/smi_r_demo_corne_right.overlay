#include "smi_r_demo_corne.dtsi"

&default_transform {
    col-offset = <6>;
};

&kscan0 {
    row-gpios
        = &gpio0 2 (GPIO_ACTIVE_HIGH | GPIO_PULL_DOWN) /* Right row 0: P0.02 */
            , &gpio0 6 (GPIO_ACTIVE_HIGH | GPIO_PULL_DOWN) /* Right row 1: P0.06 */
            , &gpio0 8 (GPIO_ACTIVE_HIGH | GPIO_PULL_DOWN) /* Right row 2: P0.08 */
            , &gpio0 9 (GPIO_ACTIVE_HIGH | GPIO_PULL_DOWN) /* Right row 3: P0.09 */
        ;

    col-gpios
        = &gpio0 10 GPIO_ACTIVE_HIGH /* Right col 0: P0.10 */
            , &gpio0 11 GPIO_ACTIVE_HIGH /* Right col 1: P0.11 */
            , &gpio0 17 GPIO_ACTIVE_HIGH /* Right col 2: P0.17 */
            , &gpio0 20 GPIO_ACTIVE_HIGH /* Right col 3: P0.20 */
            , &gpio0 22 GPIO_ACTIVE_HIGH /* Right col 4: P0.22 */
            , &gpio0 24 GPIO_ACTIVE_HIGH /* Right col 5: P0.24 */
        ;
};

&encoder_1 {
    status = "okay";
};

